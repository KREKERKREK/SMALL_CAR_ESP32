#include <Wire.h>
#include <AS5600.h>

// Создаем объекты энкодеров, привязывая их к разным аппаратным шинам I2C ESP32
AS5600 enc1(&Wire);  // Первый энкодер (пины 21, 22)
AS5600 enc2(&Wire1); // Второй энкодер (пины 25, 26)

// Переменные для хранения предыдущих значений (нужны для расчета разницы)
int prev1 = 0;
int prev2 = 0;
unsigned long prevTime = 0;

void setup() {
  Serial.begin(115200); // Запускаем монитор порта
  
  // Инициализируем шины I2C на нужных пинах
  Wire.begin(21, 22);
  Wire1.begin(25, 26);
  
  // Запускаем энкодеры
  enc1.begin();
  enc2.begin();
  
  // Считываем начальные значения, чтобы при первом запуске loop 
  // не было ложного огромного скачка скорости
  prev1 = enc1.readAngle();
  prev2 = enc2.readAngle();
  prevTime = micros(); // Засекаем начальное время в микросекундах
}

void loop() {
  // 1. Считаем прошедшее время
  unsigned long now = micros();
  float dt = (now - prevTime) / 1000000.0; // Переводим микросекунды в секунды
  
  // Защита: если прошло слишком мало времени, пропускаем цикл, 
  // чтобы не делить на ноль и не получать шум
  if (dt < 0.01) return; 

  // 2. Считываем текущие "сырые" значения угла (от 0 до 4095)
  int curr1 = enc1.readAngle();
  int curr2 = enc2.readAngle();

  // 3. Находим разницу (насколько повернулся вал)
  int d1 = curr1 - prev1;
  int d2 = curr2 - prev2;

  // 4. Исправление перехода через ноль (граница 360° -> 0°)
  // Если разница больше половины круга (2048), значит мы перешли границу
  if (d1 > 2048) d1 -= 4096;
  if (d1 < -2048) d1 += 4096;
  
  if (d2 > 2048) d2 -= 4096;
  if (d2 < -2048) d2 += 4096;

  // 5. Расчет скорости в градусах в секунду
  // Формула: (разница_в_шагах * градусы_на_шаг) / прошедшее_время
  float speed1 = (d1 * 360.0 / 4096.0) / dt;
  float speed2 = (d2 * 360.0 / 4096.0) / dt;

  // 6. Выводим скорости в монитор порта (1 знак после запятой)
  Serial.print(speed1, 1);
  Serial.print(" "); // Разделитель
  Serial.println(speed2, 1);

  // 7. Сохраняем текущие значения как "предыдущие" для следующего цикла
  prev1 = curr1;
  prev2 = curr2;
  prevTime = now;
  
  // Небольшая задержка, чтобы не перегружать процессор и порт
  delay(20); 
}
